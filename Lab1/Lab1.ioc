# file: Lab1.ioc
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Mcu.Family=STM32L4
RCC.MSI_VALUE=4000000
RCC.CortexFreq_Value=80000000
RCC.SYSCLKSource=RCC_SYSCLKSOURCE_PLLCLK
ProjectManager.StackSize=0x400
PB3\ (JTDO-TRACESWO).Signal=SYS_JTDO-SWO
ProjectManager.TargetToolchain=STM32CubeIDE
RCC.HCLKFreq_Value=80000000
RCC.APB2TimFreq_Value=80000000
RCC.USBFreq_Value=48000000
RCC.AHBFreq_Value=80000000
RCC.HSE_VALUE=8000000
board=B-L475E-IOT01A1
RCC.VCOOutputFreq_Value=160000000
RCC.APB2Freq_Value=80000000
RCC.ADCFreq_Value=48000000
Mcu.Name=STM32L475V(C-E-G)Tx
RCC.SYSCLKFreq_VALUE=80000000
Mcu.Package=LQFP100
ProjectManager.HeapSize=0x200
RCC.HSI_VALUE=16000000
NVIC.PriorityGroup=NVIC_PRIORITYGROUP_4
RCC.PLLN=40
RCC.APB1TimFreq_Value=80000000
PA13\ (JTMS-SWDIO).Signal=SYS_JTMS-SWDIO
RCC.APB1Freq_Value=80000000
RCC.PLLSAI1N=24

// file: Core/Src/main.c
/* USER CODE BEGIN Header */
/**
  ******************************************************************************
  * @file           : main.c
  * @brief          : Main program body
  ******************************************************************************
  * @attention
  *
  * <h2><center>&copy; Copyright (c) 2020 STMicroelectronics.
  * All rights reserved.</center></h2>
  *
  * This software component is licensed by ST under BSD 3-Clause license,
  * the "License"; You may not use this file except in compliance with the
  * License. You may obtain a copy of the License at:
  *                        opensource.org/licenses/BSD-3-Clause
  *
  ******************************************************************************
  */
/* USER CODE END Header */
#include "main.h"

/* USER CODE BEGIN Includes */

#define ARM_MATH_CM4
#include "arm_math.h"
#include "lab1math.h"

/* USER CODE END Includes */

/* USER CODE BEGIN PD */
#define ITM_Port32(n)(*((volatile unsigned long*)(0xE0000000+4*n)))
/* USER CODE END PD */

void SystemClock_Config(void);
static void MX_GPIO_Init(void);

int main(void)
{

  /* MCU Configuration--------------------------------------------------------*/

  /* Reset of all peripherals, Initializes the Flash interface and the Systick. */
  HAL_Init();

  /* Configure the system clock */
  SystemClock_Config();

  /* Initialize all configured peripherals */
  MX_GPIO_Init();
  /* USER CODE BEGIN 2 */
  //mult

  float arrayA[1000];
  float arrayB[1000];
  float arrayY_C[1000];
  float arrayY_ASM[1000];
  float arrayY_CMSIS[1000];
  uint32_t blockSize = 1000;
  for (uint32_t i = 0; i<1000; i++){
	  arrayA[i] = 1.1*(i+1);
	  arrayB[i] = 1.1*(i+1);
  }

  //standard deviation
  /*
  float arrayX[1000];
  uint32_t size = 1000;
  for (uint32_t i = 0; i<1000; i++){
	  arrayX[i] = 1.1*(i+1);
  }
  float std_C;
  float std_ASM;
  float std_CMSIS;
*/
  /* USER CODE END 2 */

  /* Infinite loop */
  while (1)
  {

    /* USER CODE BEGIN 3 */

	  //mult

	  ITM_Port32(31) = 1;
	  cMult(&arrayA, &arrayB, &arrayY_C, blockSize);
	  ITM_Port32(31) = 2;
	  asmMult(&arrayA, &arrayB, &arrayY_ASM, blockSize);
	  ITM_Port32(31) = 3;
	  arm_mult_f32(&arrayA, &arrayB, &arrayY_CMSIS, blockSize);
	  ITM_Port32(31) = 4;

	  //standard deviation
	  /*
	  ITM_Port32(31) = 1;
	  cSTD(&arrayX, size, &std_C);
	  ITM_Port32(31) = 2;
	  asmSTD(&arrayX, size, &std_ASM);
	  ITM_Port32(31) = 3;
	  arm_std_f32(&arrayX, size, &std_CMSIS);
	  ITM_Port32(31) = 4;
	  */

  }
  /* USER CODE END 3 */
}

void SystemClock_Config(void)
{
  RCC_OscInitTypeDef RCC_OscInitStruct = {0};
  RCC_ClkInitTypeDef RCC_ClkInitStruct = {0};

  /** Initializes the RCC Oscillators according to the specified parameters
  * in the RCC_OscInitTypeDef structure.
  */
  RCC_OscInitStruct.OscillatorType = RCC_OSCILLATORTYPE_MSI;
  RCC_OscInitStruct.MSIState = RCC_MSI_ON;
  RCC_OscInitStruct.MSICalibrationValue = 0;
  RCC_OscInitStruct.MSIClockRange = RCC_MSIRANGE_6;
  RCC_OscInitStruct.PLL.PLLState = RCC_PLL_ON;
  RCC_OscInitStruct.PLL.PLLSource = RCC_PLLSOURCE_MSI;
  RCC_OscInitStruct.PLL.PLLM = 1;
  RCC_OscInitStruct.PLL.PLLN = 40;
  RCC_OscInitStruct.PLL.PLLP = RCC_PLLP_DIV7;
  RCC_OscInitStruct.PLL.PLLQ = RCC_PLLQ_DIV2;
  RCC_OscInitStruct.PLL.PLLR = RCC_PLLR_DIV2;
  if (HAL_RCC_OscConfig(&RCC_OscInitStruct) != HAL_OK)
  {
    Error_Handler();
  }
  /** Initializes the CPU, AHB and APB buses clocks
  */
  RCC_ClkInitStruct.ClockType = RCC_CLOCKTYPE_HCLK|RCC_CLOCKTYPE_SYSCLK
                              |RCC_CLOCKTYPE_PCLK1|RCC_CLOCKTYPE_PCLK2;
  RCC_ClkInitStruct.SYSCLKSource = RCC_SYSCLKSOURCE_PLLCLK;
  RCC_ClkInitStruct.AHBCLKDivider = RCC_SYSCLK_DIV1;
  RCC_ClkInitStruct.APB1CLKDivider = RCC_HCLK_DIV1;
  RCC_ClkInitStruct.APB2CLKDivider = RCC_HCLK_DIV1;

  if (HAL_RCC_ClockConfig(&RCC_ClkInitStruct, FLASH_LATENCY_4) != HAL_OK)
  {
    Error_Handler();
  }
  /** Configure the main internal regulator output voltage
  */
  if (HAL_PWREx_ControlVoltageScaling(PWR_REGULATOR_VOLTAGE_SCALE1) != HAL_OK)
  {
    Error_Handler();
  }
}

static void MX_GPIO_Init(void)
{

  /* GPIO Ports Clock Enable */
  __HAL_RCC_GPIOA_CLK_ENABLE();
  __HAL_RCC_GPIOB_CLK_ENABLE();

}

void Error_Handler(void)
{
}

/************************ (C) COPYRIGHT STMicroelectronics *****END OF FILE****/
